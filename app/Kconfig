## app/Kconfig
```kconfig
mainmenu "Zephyr Course Application"

config APP_HEARTBEAT_PERIOD_MS
    int "Heartbeat sleep period (ms)"
    range 100 2000
    default 500

source "Kconfig.zephyr"
```

## app/boards/our_f401cc/board.yml
```yaml
board:
  name: our_f401cc
  full_name: Our F401C V1.2
  vendor: ahsan
  socs:
    - name: stm32f401xc
```

## app/boards/our_f401cc2/board.yml
```yaml
board:
  name: our_f401cc2
  full_name: Our F401C 2
  vendor: ahsan
  socs:
    - name: stm32f401xc
```

## app/boards/scratch_f401cc/board.yml
```yaml
board:
  name: scratch_f401cc
  full_name: Custom board from Scratch
  vendor: ahsan
  socs:
    - name: stm32f401xc
```
